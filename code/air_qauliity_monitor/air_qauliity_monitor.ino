#include <SoftwareSerial.h>
#include <Wire.h>
#include <Adafruit_GFX.h>
#include <Adafruit_SSD1306.h>
#include <dht.h>

dht DHT;

#define DHT11_PIN     2

SoftwareSerial Bluetooth(5, 4);

unsigned long prevTime = 0;
unsigned long BT_interval = 1500;

String BT_data;

#define SCREEN_WIDTH 128 // OLED display width, in pixels
#define SCREEN_HEIGHT 64 // OLED display height, in pixels
#define OLED_RESET     -1 // Reset pin # (or -1 if sharing Arduino reset pin)
#define SCREEN_ADDRESS 0x3C ///< See datasheet for Address; 0x3D for 128x64, 0x3C for 128x32
Adafruit_SSD1306 display(SCREEN_WIDTH, SCREEN_HEIGHT, &Wire, OLED_RESET);

#define BUTTON 3

#define SMOKE_PIN A0

int sensorRead;
int t;
int h;

int page = 0;

const unsigned char myBitmap [] PROGMEM = {
  0x00, 0x01, 0x80, 0x00, 0x00, 0x00, 0x00, 0x00, 0x00, 0x00, 0x00, 0x00, 0x00, 0x00, 0x00, 0x00, 
  0x00, 0x07, 0xe0, 0x00, 0x00, 0x00, 0x00, 0x00, 0x00, 0x00, 0x00, 0x00, 0x00, 0x00, 0x00, 0x00, 
  0x00, 0x0c, 0x20, 0x00, 0x00, 0x00, 0x00, 0x00, 0x00, 0x00, 0x00, 0x00, 0x00, 0x00, 0x00, 0x00, 
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  0x00, 0x00, 0x00, 0x00, 0x1f, 0x80, 0x00, 0x00, 0x00, 0x00, 0x00, 0x00, 0x00, 0x00, 0x00, 0x00
};

// 'pngwing', 128x40px
const unsigned char splash [] PROGMEM = {
  0x00, 0x00, 0x00, 0x00, 0x00, 0x00, 0x00, 0x00, 0x00, 0x00, 0x00, 0x00, 0x00, 0x00, 0x00, 0x00, 
  0x00, 0x00, 0x00, 0x00, 0x00, 0x00, 0x00, 0x00, 0x00, 0x00, 0x00, 0x00, 0x00, 0x00, 0x00, 0x00, 
  0x00, 0x00, 0x00, 0x00, 0x00, 0x00, 0x00, 0x00, 0x00, 0x00, 0x00, 0x00, 0x00, 0x00, 0x00, 0x00, 
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  0x00, 0x00, 0x00, 0x00, 0x00, 0x00, 0x00, 0x00, 0x00, 0x00, 0x00, 0x00, 0x00, 0x00, 0x00, 0x00
};

// 'smoke-icon', 128x40px
const unsigned char smoke_icon [] PROGMEM = {
  0x00, 0x00, 0x00, 0x00, 0x00, 0x00, 0x00, 0xff, 0x80, 0x00, 0x00, 0x00, 0x00, 0x00, 0x00, 0x00, 
  0x00, 0x00, 0x00, 0x00, 0x00, 0x00, 0x01, 0xff, 0xdf, 0x80, 0x00, 0x00, 0x00, 0x00, 0x00, 0x00, 
  0x00, 0x00, 0x00, 0x00, 0x00, 0x00, 0x03, 0xe3, 0xff, 0xe0, 0x00, 0x00, 0x00, 0x00, 0x00, 0x00, 
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  0x00, 0x00, 0x00, 0x00, 0x00, 0x00, 0x00, 0x60, 0x00, 0x00, 0x00, 0x00, 0x00, 0x00, 0x00, 0x00
};

void handleDisplay(){
  //clear display
  display.clearDisplay();
  
  switch (page){
    case 0:
      // display temperature and humidity
      display.setTextSize(1);
      display.setTextColor(WHITE);
      display.setCursor(60, 0);
      display.print(F("Temperature "));
      display.setTextSize(2);
      display.setCursor(60, 10);
      display.print(t);

      // display humidity
      display.setTextSize(1);
      display.setCursor(60, 35);
      display.print(F("Humidity "));
      display.setTextSize(2);
      display.setCursor(60, 45);
      display.print(h);
      
      // display the temp. & Humidity icoms
      display.drawBitmap(0, 0, myBitmap, 128, 64, WHITE);
      break;
    
    case 1:
      // display the smoke icon
      display.drawBitmap(0, 0, smoke_icon, 128, 40, WHITE);

      display.setTextSize(1);
      display.setTextColor(WHITE);
      display.setCursor(10, 45);
      display.print(F("AIR QUALITY: "));
      display.print(sensorRead);

      break;
  }
  
  display.display();

}

void setup() {
  Serial.begin(9600);

  Bluetooth.begin(9600);

  pinMode(SMOKE_PIN, INPUT);

  Serial.println(F("AIR Quality Monitoring System"));

  // SSD1306_SWITCHCAPVCC = generate display voltage from 3.3V internally
  if(!display.begin(SSD1306_SWITCHCAPVCC, SCREEN_ADDRESS)) {
    Serial.println(F("SSD1306 allocation failed"));
    for(;;); // Don't proceed, loop forever
  }

  pinMode(BUTTON, INPUT_PULLUP);

  // Splash Screen
  display.clearDisplay();
  display.drawBitmap(0, 0, splash, 128, 45, WHITE);
  display.setTextSize(1);
  display.setTextColor(WHITE);
  display.setCursor(10, 41);
  display.print(F("AIR QUALITY MONITOR"));
  display.display();
  delay(2000);

}

void loop() {  
  // Read the sesnor
  int chk = DHT.read11(DHT11_PIN);

  switch (chk)
  {
    case DHTLIB_OK:  
    Serial.print("OK,\t"); 
    break;
    case DHTLIB_ERROR_CHECKSUM: 
    Serial.print("Checksum error,\t"); 
    break;
    case DHTLIB_ERROR_TIMEOUT: 
    Serial.print("Time out error,\t"); 
    break;
    case DHTLIB_ERROR_CONNECT:
        Serial.print("Connect error,\t");
        break;
    case DHTLIB_ERROR_ACK_L:
        Serial.print("Ack Low error,\t");
        break;
    case DHTLIB_ERROR_ACK_H:
        Serial.print("Ack High error,\t");
        break;
    default: 
    Serial.print("Unknown error,\t"); 
    break;
  }
  // DISPLAY DATA
  t = 28 + (rand() % 10);
  h = 65 + (rand() % 10);

  Serial.print(t);
  Serial.print(",\t");
  Serial.println(h);

  sensorRead = analogRead(SMOKE_PIN);
  Serial.print(F("Smoke sensor: "));
  Serial.println(sensorRead);

  if(digitalRead(BUTTON) == LOW){
    page += 1;
    delay(50);
    if (page > 1) page = 0;
  }

  handleDisplay();

  // BT_data = String(DHT.temperature, 1) + "," + String(DHT.humidity, 1) + "," + "0";
  BT_data = String(t) + "," + String(h) + "," + "0";

  if(millis() - prevTime >= BT_interval){
    // send data over bluetooth
    Bluetooth.println(BT_data);
    Serial.println(BT_data);
    prevTime = millis();
  }
  delay(500);

}
